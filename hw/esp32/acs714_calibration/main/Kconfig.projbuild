## hw/esp32/acs714_calibration/main/Kconfig.projbuild
```kconfig
menu "ACS714 calibration utility"

config ACS714_ADC_CHANNEL
    int "ADC1 channel"
    range 0 9
    default 6
    help
        ADC1 channel connected to the midpoint of the 10 kOhm / 10 kOhm
        ACS714 output divider. Verify the channel-to-GPIO mapping for the
        selected ESP32 target before wiring the board.

config ACS714_SAMPLE_COUNT
    int "Samples per measurement"
    range 100 10000
    default 1000
    help
        Number of calibrated ADC samples averaged for each zero or current
        point measurement.

config ACS714_SAMPLE_PERIOD_US
    int "Sample period in microseconds"
    range 0 1000000
    default 1000
    help
        Delay between samples during calibration. Zero means sample as fast
        as the ADC driver permits.

config ACS714_MONITOR_PERIOD_MS
    int "ADC monitor period in milliseconds"
    range 10 10000
    default 100
    help
        Period between lines printed by the background ADC monitor command.

endmenu
```

## hw/esp32/as5600_example/main/Kconfig.projbuild
```kconfig
menu "AS5600 example"

config AS5600_SDA_GPIO
    int "I2C SDA GPIO"
    default 21
    range 0 48
    help
        GPIO connected to AS5600 SDA. Use an ESP32 GPIO that supports I2C.

config AS5600_SCL_GPIO
    int "I2C SCL GPIO"
    default 22
    range 0 48
    help
        GPIO connected to AS5600 SCL. Use an ESP32 GPIO that supports I2C.

config AS5600_I2C_FREQ_HZ
    int "I2C frequency in Hz"
    default 400000
    range 10000 1000000
    help
        I2C bus frequency. 400000 is a conservative starting point.

config AS5600_SAMPLE_PERIOD_MS
    int "Angle sample period in milliseconds"
    default 100
    range 1 10000
    help
        Delay between angle samples printed by the example.

endmenu
```

## hw/esp32/as5600_example/sdkconfig.defaults
```kconfig
CONFIG_FREERTOS_HZ=1000
CONFIG_ESP_CONSOLE_UART_DEFAULT=y
CONFIG_ESP_CONSOLE_UART_BAUDRATE=115200
CONFIG_LOG_DEFAULT_LEVEL=3
```

## hw/focmini/idf/main/Kconfig.projbuild
```kconfig
menu "FOCMini motor setup"

config FOCMINI_BUS_MV
	int "Measured motor supply voltage (mV)"
	 range 0 30000
	 default 0
	 help
		Zero disarms the motor. Enter the measured supply voltage only after wiring review.

config FOCMINI_POLE_PAIRS
	int "Verified motor pole pairs"
	 range 0 64
	 default 0
	 help
		Zero disarms the motor. This is pole pairs, not the number of poles.

config FOCMINI_VOLTAGE_LIMIT_MV
	int "Initial motor phase amplitude limit (mV)"
	 range 100 30000
	 default 500
	 help
		This is the motor phase amplitude, not the driver's full bus-voltage range.
		Centered sine modulation requires twice this amplitude to fit within the bus.
		Voltage-mode control cannot enforce current.

config FOCMINI_VELOCITY_LIMIT_MRAD_S
	int "Velocity command limit (millirad/s, maximum 5 rad/s)"
	 range 1 5000
	 default 5000
	 help
		Initial bring-up limit is 5 rad/s (about 48 RPM), not a measured motor rating.

config FOCMINI_USE_AS5600
	bool "Use AS5600 closed-loop velocity mode"
	default n
	help
		Leave disabled for first open-loop bring-up. Enable only after encoder wiring and magnet alignment.

endmenu
```
